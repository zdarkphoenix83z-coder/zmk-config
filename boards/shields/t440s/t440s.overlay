/ {
    kscan0: kscan {
        compatible = "zmk,kscan-gpio-matrix";

        row-gpios = <
            &pro_micro 2 GPIO_ACTIVE_LOW
            &pro_micro 29 GPIO_ACTIVE_LOW
            &pro_micro 31 GPIO_ACTIVE_LOW
            &pro_micro 115 GPIO_ACTIVE_LOW
            &pro_micro 113 GPIO_ACTIVE_LOW
        >;

        col-gpios = <
            &pro_micro 111 GPIO_ACTIVE_LOW
            &pro_micro 100 GPIO_ACTIVE_LOW
        >;

        diode-direction = "col2row";
    };
};