## config/west.yml
```yaml
manifest:
  remotes:
    - name: zmkfirmware
      url-base: https://github.com/zmkfirmware

  projects:
    - name: zmk
      remote: zmkfirmware
      revision: main
      import: app/west.yml

  self:
    path: config

  # 🔥 THÊM PHẦN NÀY
  groups:
    - name: modules
      projects:
        - name: t440s
          path: modules/t440s
```
